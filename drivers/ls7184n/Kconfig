## drivers/ls7184n/Kconfig
```kconfig
menu "LS7184N driver"
config LS7184N
    bool "Enable LS7184N quadrature decoder driver"
    depends on GPIO && SENSOR

if LS7184N
    module = LS7184N_DRIVER
    module-str = LS7184N driver
    source "subsys/logging/Kconfig.template.log_config"
endif
endmenu
```

## drivers/stspin240/Kconfig
```kconfig
menu "STSPIN240 driver"
config STSPIN240
    bool "Enable STSPIN240 dual brushed DC motor driver"
    depends on PWM && GPIO

if STSPIN240
    config STSPIN240_DEVICE_PM
        bool "Enable STSPIN240 device power management"
        default PM_DEVICE
        depends on PM_DEVICE
        
    module = STSPIN240_DRIVER
    module-str = STSPIN240 driver
    source "subsys/logging/Kconfig.template.log_config"

    module = STSPIN240_MOTOR_DRIVER
    module-str = STSPIN240 motor driver
    source "subsys/logging/Kconfig.template.log_config"
endif
endmenu
```
